## PebbleOS/boards/coredevices/p2ddk/Kconfig.p2ddk
```kconfig
# Copyright (c) 2025 Core Devices LLC
# SPDX-License-Identifier: Apache-2.0

config BOARD_P2DDK
	select SOC_NRF52840_QIAA
```

## PebbleOS/boards/coredevices/p2ddk/board.yml
```yaml
# Copyright (c) 2025 Core Devices LLC
# SPDX-License-Identifier: Apache-2.0

boards:
- name: p2ddk
  full_name: Pebble 2 Duo DevKit
  vendor: coredevices
  socs:
  - name: nrf52840
```

## PebbleOS/boards/coredevices/p2ddk/p2ddk_defconfig
```kconfig
# Copyright (c) 2025 Core Devices LLC
# SPDX-License-Identifier: Apache-2.0

CONFIG_ARM_MPU=y
CONFIG_HW_STACK_PROTECTION=y

CONFIG_GPIO=y
CONFIG_SERIAL=y

CONFIG_CONSOLE=y
CONFIG_UART_CONSOLE=y

# Need this when storage is on MX25R64
CONFIG_NORDIC_QSPI_NOR=y
CONFIG_NORDIC_QSPI_NOR_FLASH_LAYOUT_PAGE_SIZE=4096

# Need increased main stack size due to fs automounting
CONFIG_MAIN_STACK_SIZE=4096
CONFIG_SYSTEM_WORKQUEUE_STACK_SIZE=4096
CONFIG_BT_RX_STACK_SIZE=2048

# Heap
CONFIG_HEAP_MEM_POOL_SIZE=8192
```

## PebbleOS/drivers/flash/Kconfig
```kconfig
# Copyright (c) 2021 Nordic Semiconductor ASA
# SPDX-License-Identifier: Apache-2.0

menu "Flash"
rsource "flash_sim/Kconfig"
endmenu
```

## PebbleOS/dts/bindings/display/sim_display/pebble-sim-display.yaml
```yaml
# Copyright (c) 2021 Nordic Semiconductor ASA
# SPDX-License-Identifier: Apache-2.0

description: Sim display controller

compatible: "pebble-sim-display"

include: display-controller.yaml
```

## PebbleOS/dts/bindings/flash/flash_sim/pebble-sim-flash.yaml
```yaml
# Copyright (c) 2021 Nordic Semiconductor ASA
# SPDX-License-Identifier: Apache-2.0

description: Sim flash controller

compatible: "pebble-sim-flash"

include: base.yaml

properties:
  filename:
    type: string
    required: true
```

## PebbleOS/tests/CoreOS/fw/applib/graphics/testcase.yaml
```yaml
tests:
  # section.subsection
  applib.graphics.ztest:
    build_only: false
    arch_allow: posix
    tags: applib.graphics
```
